        .global instr_mnemonics, opcode_instr, opcode_operands

;;
; All possible 65816 instructions.
;
.struct Instr
        ADC .byte ; $00
        AND .byte ; $01
        ASL .byte ; $02
        BIT .byte ; $03
        BRK .byte ; $04
        CLC .byte ; $05
        CLD .byte ; $06
        CLI .byte ; $07
        CLV .byte ; $08
        CMP .byte ; $09
        COP .byte ; $0A
        CPX .byte ; $0B
        CPY .byte ; $0C
        DEC .byte ; $0D
        DEX .byte ; $0E
        DEY .byte ; $0F
        EOR .byte ; $10
        INC .byte ; $11
        INX .byte ; $12
        INY .byte ; $13
        JML .byte ; $14
        JMP .byte ; $15
        JSL .byte ; $16
        JSR .byte ; $17
        LDA .byte ; $18
        LDX .byte ; $19
        LDY .byte ; $1A
        LSR .byte ; $1B
        MVN .byte ; $1C
        MVP .byte ; $1D
        NOP .byte ; $1E
        ORA .byte ; $1F
        PEA .byte ; $20
        PEI .byte ; $21
        PHA .byte ; $22
        PHB .byte ; $23
        PHD .byte ; $24
        PHK .byte ; $25
        PHP .byte ; $26
        PHX .byte ; $27
        PHY .byte ; $28
        PLA .byte ; $29
        PLB .byte ; $2A
        PLD .byte ; $2B
        PLP .byte ; $2C
        PLX .byte ; $2D
        PLY .byte ; $2E
        REP .byte ; $2F
        ROL .byte ; $30
        ROR .byte ; $31
        RTI .byte ; $32
        RTL .byte ; $33
        RTS .byte ; $34
        SBC .byte ; $35
        SEC .byte ; $36
        SED .byte ; $37
        SEI .byte ; $38
        SEP .byte ; $39
        STA .byte ; $3A
        STP .byte ; $3B
        STX .byte ; $3C
        STY .byte ; $3D
        STZ .byte ; $3E
        TAX .byte ; $3F
        TAY .byte ; $40
        TCD .byte ; $41
        TCS .byte ; $42
        TDC .byte ; $43
        TRB .byte ; $44
        TSB .byte ; $45
        TSC .byte ; $46
        TSX .byte ; $47
        TXA .byte ; $48
        TXS .byte ; $49
        TXY .byte ; $4A
        TYA .byte ; $4B
        TYX .byte ; $4C
        WAI .byte ; $4D
        WDC .byte ; $4E
        WDM .byte ; $4F
        XBA .byte ; $50
        XCE .byte ; $51
        BCC .byte ; $52
        BCS .byte ; $53
        BEQ .byte ; $54
        BMI .byte ; $55
        BNE .byte ; $56
        BPL .byte ; $57
        BRA .byte ; $58
        BVC .byte ; $59
        BVS .byte ; $5A
        BRL .byte ; $5B
        PER .byte ; $5C
.endstruct
